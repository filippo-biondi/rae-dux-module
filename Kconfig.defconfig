## Kconfig.defconfig
```kconfig
if SHIELD_RAE_DUX_LEFT

config ZMK_KEYBOARD_NAME
    default "Rae Dux"

config ZMK_SPLIT_ROLE_CENTRAL
    default y

endif

if SHIELD_RAE_DUX_LEFT || SHIELD_RAE_DUX_RIGHT

config ZMK_SPLIT
    default y

endif
```

## boards/shields/rae_dux_24/Kconfig.defconfig
```kconfig
if SHIELD_RAE_DUX_24_LEFT

config ZMK_KEYBOARD_NAME
    default "Rae Dux 24 M"

config ZMK_SPLIT_ROLE_CENTRAL
    default y

endif

if SHIELD_RAE_DUX_24_RIGHT

config ZMK_KEYBOARD_NAME
    default "Rae Dux 24 S"

config ZMK_SPLIT_ROLE_CENTRAL
    default n


endif

if SHIELD_RAE_DUX_24_LEFT || SHIELD_RAE_DUX_24_RIGHT

config ZMK_SPLIT
    default y

endif
```

## boards/shields/rae_dux_24/Kconfig.shield
```kconfig
config SHIELD_RAE_DUX_24_LEFT
    def_bool $(shields_list_contains,rae_dux_24_left)

config SHIELD_RAE_DUX_24_RIGHT
    def_bool $(shields_list_contains,rae_dux_24_right)
```

## dts/bindings/behaviors/zmk,behavior-auto-cap.yaml
```yaml
description: Auto capital behavior

compatible: "zmk,behavior-auto-cap"

include: zero_param.yaml

properties:
  trigger-keys:
    type: array
    required: true
    default: []
```

## dts/bindings/behaviors/zmk,behavior-magic-key.yaml
```yaml
description: Magic Key behavior

compatible: "zmk,behavior-magic-key"

include: zero_param.yaml

properties:
  usage-pages:
    type: array
    required: true
  dictionary-keys:
    type: array
    required: true
    default: []
  bindings:
    type: phandle-array
    required: true
```
